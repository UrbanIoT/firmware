## drivers/sensor/Kconfig
```kconfig
# SPDX-License-Identifier: Apache-2.0

if SENSOR
rsource "examplesensor/Kconfig"
rsource "hm3x00/Kconfig"
endif # SENSOR
```

## drivers/sensor/hm3x00/Kconfig
```kconfig
menuconfig HM3X00
	bool "Laser PM2.5 Sensor (HM3300/HM3600)"
	default y
	depends on DT_HAS_SEEED_HM3X00_ENABLED
	select I2C
	help
	  Enable driver Laser PM2.5 Sensor (HM3300/HM3600) sensor.


choice "HM3X00_VALUE_CHOICE"
	prompt "Sensor return values"
	default HM3X00_CF1_STANDARD_PARTICULATE
	depends on HM3X00

config HM3X00_CF1_STANDARD_PARTICULATE
	bool "CF=1, Standard particulate"

config HM3X00_ATMOSPHERIC_ENVIRONMENT
	bool "Atmospheric environment"

endchoice

config HM3X00_RETURN_VALUES
	int
	depends on HM3X00
	default 0 if HM3X00_CF1_STANDARD_PARTICULATE
	default 1 if HM3X00_ATMOSPHERIC_ENVIRONMENT
```

## dts/bindings/sensor/seeed,hm3x00.yaml
```yaml
# SPDX-License-Identifier: Apache-2.0

description: |
  HM-3300/3600 is a new generation of laser dust detection sensor developed by our
  company, used for continuous and real-time detection of dust in the air.
  Different from the pumping dust detection sensor, the HM-3300/3600 innovatively uses fan
  blades to drive air, and the air flowing through the detection chamber is used as a test sample to
  perform real-time and continuous test on dust of different particle sizes in the air.
  HM-3300/3600 is suitable for dust detectors, intelligent air purifiers, intelligent air
  conditioners, intelligent ventilation fans, air quality testing, haze meters, environmental monitoring
  and relative products and applications.

compatible: "seeed,hm3x00"

include: i2c-device.yaml
```

## lib/minmea/Kconfig
```kconfig
# SPDX-License-Identifier: Apache-2.0

config MINMEA
	bool "minmea Support"
	help
	  Minmea is a minimalistic GPS parser library written in pure C intended for resource-constrained platforms, especially microcontrollers and other embedded systems.
```

## tests/lib/custom_lib/testcase.yaml
```yaml
common:
  tags: extensibility
  integration_platforms:
    - custom_plank
    - rpi_pico
    - qemu_cortex_m0
    - qemu_x86
tests:
  lib.custom_lib: {}
  lib.custom_lib.non_default:
    extra_args: CONFIG_CUSTOM_LIB_GET_VALUE_DEFAULT=6
```

## west.yml
```yaml
# SPDX-License-Identifier: Apache-2.0

manifest:
  self:
    west-commands: scripts/west-commands.yml

  remotes:
    - name: zephyrproject-rtos
      url-base: https://github.com/zephyrproject-rtos

  projects:
    - name: zephyr
      remote: zephyrproject-rtos
      revision: v3.2.0
      import:
        name-allowlist:
          - cmsis
          - hal_rpi_pico
    # - name: minmea
    #   url: https://github.com/capsoid/minmea
    #   revision: master
    #   path: minmea
```
